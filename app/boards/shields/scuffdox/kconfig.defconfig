## app/boards/shields/scuffdox/kconfig.defconfig
```kconfig
if SHIELD_SCUFFDOX_LEFT

config ZMK_KEYBOARD_NAME
    default "Scuffdox"

config ZMK_SPLIT_BLE_ROLE_CENTRAL
    default y

endif

if SHIELD_SCUFFDOX_LEFT || SHIELD_SCUFFDOX_RIGHT

config ZMK_SPLIT
    default y

endif
```

## app/boards/shields/scuffdox/kconfig.shield
```kconfig
config SHIELD_SCUFFDOX_LEFT
    def_bool $(shields_list_contains,scuffdox_left)

config SHIELD_SCUFFDOX_RIGHT
    def_bool $(shields_list_contains,scuffdox_right)
```
